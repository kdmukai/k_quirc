## Kconfig
```kconfig
menu "K-Quirc QR Decoder"

    config K_QUIRC_CONTRAST_STRETCH
        bool "Enable contrast stretch before thresholding"
        default y
        help
            Stretches the grayscale histogram with percentile clipping
            before Otsu thresholding. Improves detection in low-contrast
            or dim lighting at a small per-frame cost (one LUT remap pass).
            Skips the remap when the image already has sufficient contrast.

    config K_QUIRC_CONTRAST_CLIP_PCT
        int "Contrast stretch clip percentage (each tail)"
        default 5
        range 1 20
        depends on K_QUIRC_CONTRAST_STRETCH
        help
            Percentage of pixels to clip from each tail of the histogram
            before stretching. 5 = clip darkest 5% and brightest 5%.

    config K_QUIRC_DEBUG
        bool "Enable QR decoder debug visualization"
        default n
        help
            Shows the thresholded pixel buffer with timing pattern overlays.
            Useful for development and debugging QR detection issues.

endmenu
```
